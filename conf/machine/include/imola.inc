## conf/machine/include/jetson-orin-nano-devkit-nvme.inc
```bitbake
require jetson-orin-nano-devkit.inc

TNSPEC_BOOTDEV = "nvme0n1p1"

PARTITION_LAYOUT_TEMPLATE_DEFAULT_SUPPORTS_REDUNDANT = "0"
HAS_REDUNDANT_PARTITION_LAYOUT_EXTERNAL = "0"
```
